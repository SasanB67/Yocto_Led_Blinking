## build/conf/bblayers.conf
```bitbake
POKY_BBLAYERS_CONF_VERSION = "2"

BBPATH = "${TOPDIR}"
BBFILES ?= ""

BBLAYERS ?= " \
  /home/sasy/Desktop/Yocto_ThreeLeds/poky/meta \
  /home/sasy/Desktop/Yocto_ThreeLeds/poky/meta-poky \
  /home/sasy/Desktop/Yocto_ThreeLeds/poky/meta-yocto-bsp \
  /home/sasy/Desktop/Yocto_ThreeLeds/meta-openembedded/meta-oe \
  /home/sasy/Desktop/Yocto_ThreeLeds/meta-openembedded/meta-python \
  /home/sasy/Desktop/Yocto_ThreeLeds/meta-openembedded/meta-networking \
  /home/sasy/Desktop/Yocto_ThreeLeds/meta-raspberrypi \
  /home/sasy/Desktop/Yocto_ThreeLeds/meta-threeleds \
  "
```

## meta-threeleds/conf/layer.conf
```bitbake
BBPATH .= ":${LAYERDIR}"
BBFILES += "${LAYERDIR}/recipes-*/*/*.bb ${LAYERDIR}/recipes-*/*/*.bbappend"
BBFILE_COLLECTIONS += "threeleds"
BBFILE_PATTERN_threeleds = "^${LAYERDIR}/"
BBFILE_PRIORITY_threeleds = "10"
LAYERDEPENDS_threeleds = "core openembedded-layer raspberrypi"
LAYERSERIES_COMPAT_threeleds = "scarthgap"

# Add the threeleds app (+ gpio tools for testing) to any image,
# e.g. core-image-minimal
RPI_EXTRA_CONFIG = "dtoverlay=disable-bt"
IMAGE_INSTALL:append = " threeleds"
```
